## meta-two/conf/layer.conf
```bitbake
BBPATH  .=      ":${LAYERDIR}"
BBFILES +=      "${LAYERDIR}/recipes-*/*/*.bb"

BBFILE_COLLECTIONS += "two"
BBFILE_PATTERN_two      = "^${LAYERDIR}/"
BBFILE_PRIORITY_two     = "5"
```
